/dts-v1/;
/ {
    chosen {
        zmk,kscan = &kscan0;
        zmk,matrix-transform = &default_transform;
    };

    kscan0: kscan {
        compatible = "zmk,kscan-gpio-shift-register";
        debounce-period = <3>;
        diode-direction = "COL2ROW";

        row-count = <6>;
        col-count = <14>;

        row-gpios = <&gpio1 4 GPIO_ACTIVE_LOW>,
                    <&gpio0 11 GPIO_ACTIVE_LOW>,
                    <&gpio1 0 GPIO_ACTIVE_LOW>,
                    <&gpio0 24 GPIO_ACTIVE_LOW>,
                    <&gpio0 22 GPIO_ACTIVE_LOW>,
                    <&gpio0 20 GPIO_ACTIVE_LOW>;

        sr-data-gpios  = <&gpio0 2 GPIO_ACTIVE_HIGH>;
        sr-clock-gpios = <&gpio0 6 GPIO_ACTIVE_HIGH>;
        sr-latch-gpios = <&gpio0 8 GPIO_ACTIVE_HIGH>;
        sr-count = <2>;
    };

    default_transform: keymap_transform_0 {
        compatible = "zmk,matrix-transform";
        rows = <6>;
        columns = <14>;

        // Временно пустая карта (84 слота), чтобы сборка прошла
        map = <
            0  1  2  3  4  5  6  7  8  9  10 11 12 13
            14 15 16 17 18 19 20 21 22 23 24 25 26 27
            28 29 30 31 32 33 34 35 36 37 38 39 40 41
            42 43 44 45 46 47 48 49 50 51 52 53 54 55
            56 57 58 59 60 61 62 63 64 65 66 67 68 69
            70 71 72 73 74 75 76 77 78 79 80 81 82 83
        >;
    };
};
