/*
 * Copyright (c) 2023 The ZMK Contributors
 *
 * SPDX-License-Identifier: MIT
 */

#include <dt-bindings/zmk/physical-layouts.h>

/ {
    physical_layouts {
        compatible = "zmk,physical-layouts";
        layouts {
            VIRIDI_KEYBOARD_60KEY {
                display-name = "Viridi Keyboard 60%";
                keys = <
                    // Row 0
                    PL_KEY(0,0)   PL_KEY(0,1)   PL_KEY(0,2)   PL_KEY(0,3)   PL_KEY(0,4)   PL_KEY(0,5)   PL_KEY(0,6)   PL_KEY(0,7)   PL_KEY(0,8)   PL_KEY(0,9)   PL_KEY(0,10)  PL_KEY(0,11)  PL_KEY(0,12)
                    // Row 1
                    PL_KEY(1,0)   PL_KEY(1,1)   PL_KEY(1,2)   PL_KEY(1,3)   PL_KEY(1,4)   PL_KEY(1,5)   PL_KEY(1,6)   PL_KEY(1,7)   PL_KEY(1,8)   PL_KEY(1,9)   PL_KEY(1,10)  PL_KEY(1,11)  PL_KEY(1,12)  PL_KEY(1,13)
                    // Row 2
                    PL_KEY(2,0)   PL_KEY(2,1)   PL_KEY(2,2)   PL_KEY(2,3)   PL_KEY(2,4)   PL_KEY(2,5)   PL_KEY(2,6)   PL_KEY(2,7)   PL_KEY(2,8)   PL_KEY(2,9)   PL_KEY(2,10)  PL_KEY(2,11)  PL_KEY(2,12)
                    // Row 3
                    PL_KEY(3,0)   PL_KEY(3,1)   PL_KEY(3,2)   PL_KEY(3,3)   PL_KEY(3,4)   PL_KEY(3,5)   PL_KEY(3,6)   PL_KEY(3,7)   PL_KEY(3,8)   PL_KEY(3,9)   PL_KEY(3,10)  PL_KEY(3,11)  PL_KEY(3,12)  PL_KEY(3,13)
                    // Row 4
                    PL_KEY(4,0)   PL_KEY(4,1)   PL_KEY(4,2)   PL_KEY(4,3)   PL_KEY(4,4)   PL_KEY(4,5)   PL_KEY(4,6)   PL_KEY(4,7)   PL_KEY(4,8)   PL_KEY(4,9)   PL_KEY(4,10)  PL_KEY(4,11)
                    // Row 5
                    PL_KEY(5,0)   PL_KEY(5,1)   PL_KEY(5,2)                 PL_KEY(5,3)                 PL_KEY(5,4)   PL_KEY(5,5)   PL_KEY(5,6)   PL_KEY(5,7)
                >;
            };
        };
    };
};
