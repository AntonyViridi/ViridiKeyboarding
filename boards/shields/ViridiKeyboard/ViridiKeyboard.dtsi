/ {
    chosen {
        zmk,kscan = &kscan0;
    };

    kscan0: kscan {
        compatible = "zmk,kscan-gpio-shift-register";
        debounce-period = <5>;
        diode-direction = "COL2ROW";
        col-count = <14>;
        row-count = <5>;

        row-gpios = <&gpio0 4 GPIO_ACTIVE_LOW>,
                    <&gpio0 24 GPIO_ACTIVE_LOW>,
                    <&gpio0 22 GPIO_ACTIVE_LOW>,
                    <&gpio0 20 GPIO_ACTIVE_LOW>,
                    <&gpio0 17 GPIO_ACTIVE_LOW>;

        sr-data-gpios = <&gpio0 2 GPIO_ACTIVE_HIGH>;   // SER
        sr-clock-gpios = <&gpio1 15 GPIO_ACTIVE_HIGH>; // SRCLK
        sr-latch-gpios = <&gpio1 13 GPIO_ACTIVE_HIGH>; // RCLK
    };
};
