## boards/shields/Kconfig.defconfig
```kconfig
if SHIELD_ViridiKeyboard

config ZMK_KEYBOARD_NAME
    default "ViridiKeyboard"

config SPI
	default y

endif # SHIELD_ViridiKeyboard
```

## boards/shields/Kconfig.shield
```kconfig
config SHIELD_ViridiKeyboard
    def_bool $(shields_list_contains,ViridiKeyboard)
```

## boards/shields/ViridiKeyboard/Kconfig.defconfig
```kconfig
if SHIELD_ViridiKeyboard

config ZMK_KEYBOARD_NAME
    string "Keyboard name"
    default "ViridiKeyboard"

# Правильный способ установки TX power
config BT_CTLR_TX_PWR
    int "Bluetooth TX power"
    default 8

# Полное отключение модуля физических раскладок
config ZMK_PHYSICAL_LAYOUTS
    bool
    default n
    select ZMK_PHYSICAL_LAYOUTS_DISABLED

# Исправление deprecated символа
config NRF_STORE_REBOOT_TYPE
    int "Reboot type storage"
    default 0

endif # SHIELD_ViridiKeyboard
```

## boards/shields/viridikeyboard/Kconfig.defconfig
```kconfig
if SHIELD_VIRIDIKEYBOARD
config ZMK_KSCAN_GPIO_74HC595
    default y
config ZMK_USB
	default y
# enable pinctrl
CONFIG_PINCTRL=y
config SPI
    default y
config ZMK_KEYBOARD_NAME
    default "ViridiKeyboard"
endif
```

## config/boards/shields/viridikeyboard/Kconfig.defconfig
```kconfig
if SHIELD_VIRIDIKEYBOARD
# enable GPIO
CONFIG_GPIO=y
config ZMK_USB
	default y
# enable pinctrl
CONFIG_PINCTRL=y
config SPI
    default y
config ZMK_KEYBOARD_NAME
    default "ViridiKeyboard"
endif
```

## config/boards/viridikeyboard/Kconfig.shield
```kconfig
config SHIELD_VIRIDIKEYBOARD
    bool "ViridiKeyboard Shield"
    def_bool y
config ZMK_KSCAN_GPIO_74HC595
    bool "Use GPIO Shift Register for KScan"
    default y
```

## config/west.yml
```yaml
manifest:
  remotes:
    - name: zmkfirmware
      url-base: https://github.com/zmkfirmware
    - name: AntonyViridi
      url-base: https://github.com/AntonyViridi
  projects:
    - name: zmk
      remote: zmkfirmware
      revision: main
      import: app/west.yml
    - name: viridikeyboard
      remote: AntonyViridi
      revision: main
  self:
    path: config
```
